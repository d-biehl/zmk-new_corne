## config/west.yml
```yaml
manifest:
  remotes:
    - name: zmkfirmware
      url-base: https://github.com/zmkfirmware
      # Additional modules containing boards/shields/custom code can be listed here as well.
      # See:
      # - https://zmk.dev/docs/features/modules
      # - https://docs.zephyrproject.org/3.5.0/develop/west/manifest.html#projects
    # - name: joelspadin
    #   url-base: https://github.com/joelspadin
  projects:
    - name: eyelash_corne
      url: https://github.com/d-biehl/zmk-new_corne
      revision: main
    - name: zmk
      remote: zmkfirmware
      revision: v0.3.0
      import: app/west.yml
    # - name: zmk-locales
    #   remote: joelspadin
    #   revision: main
  self:
    path: config
```
